#include "socfpga_cyclone5_de0.dtsi"

/{
    /************************************************************/
    /* Add your device tree node                                */
    /* for your Platform Designer component here                */
    /* Example node with naming convention:                     */
    /************************************************************/
    /* 	my_label: platform_designer_name@component_address {    */
    /*      compatible = "my_initials,platform_designer_name";  */
    /*      reg = <component_address length>;                   */
    /*  };                                                      */
    /************************************************************/

    my_hardware: my_component@ff204100 {    
	    compatible = "rks,my_component";  
	    reg = <0xff204100 0x10>; 
    };

};

&spi0 {
    status = "okay";
};

